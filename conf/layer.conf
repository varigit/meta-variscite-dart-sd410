## conf/layer.conf
```bitbake
# We have a conf and classes directory, add to BBPATH
BBPATH .= ":${LAYERDIR}"

# We have a packages directory, add to BBFILES
BBFILES += "${LAYERDIR}/recipes-*/*/*.bb \
            ${LAYERDIR}/recipes-*/*/*.bbappend"

BBFILE_COLLECTIONS += "variscite"
BBFILE_PATTERN_variscite := "^${LAYERDIR}/"
BBFILE_PRIORITY_variscite = "7"

QCOM_EULA_FILE = "${LAYERDIR}/conf/EULA"
```

## conf/machine/dart-sd410.conf
```bitbake
#@TYPE: Machine
#@NAME: dart-sd410
#@DESCRIPTION: Machine configuration for the DragonBoard 410c (96boards), with Qualcomm Snapdragon 410 APQ8016.

require conf/machine/include/qcom-apq8016.inc

MACHINE_FEATURES = "usbhost usbgadget alsa screen wifi bluetooth ext2 iperf i2ctools debug-tweaks tools-testapps bla blalll"

KERNEL_IMAGETYPE = "Image"
KERNEL_DEVICETREE = "qcom/apq8016-var-sd410.dtb"

SERIAL_CONSOLE = "115200 ttyMSM0"

MACHINE_ESSENTIAL_EXTRA_RRECOMMENDS += " \
    kernel-modules \
    ${@bb.utils.contains('DISTRO_FEATURES', 'opengl', 'mesa-driver-msm', '', d)} \
    ${@bb.utils.contains('DISTRO_FEATURES', 'wifi', 'wcnss-config wcnss-start', '', d)} \
    ${@bb.utils.contains('DISTRO_FEATURES', 'bluez5', 'bluez5-noinst-tools', '', d)} \
    ${@'firmware-qcom-dragonboard410c' if d.getVar('ACCEPT_EULA_dart-sd410', True) == '1' else ''} \
"

CMDLINE = "console=ttyMSM0,115200n8 root=/dev/mmcblk0p10 rootwait"

# add some useful debug tools
EXTRA_IMAGE_FEATURES += "ssh-server-dropbear"
CORE_IMAGE_EXTRA_INSTALL += "\
    coreutils \
    gptfdisk \
    e2fsprogs-resize2fs \
	packagegroup-base-wifi \
    packagegroup-core-full-cmdline \
    packagegroup-base-bluetooth \
    iperf \
    alsa-utils \
    i2c-tools \
    devmem2 \
    dtc \
    dtc-misc \
    iproute2 \
    iptables \
"
```
